## CMakeLists.txt
```
# SPDX-License-Identifier: Apache-2.0

cmake_minimum_required(VERSION 3.20.0)

find_package(Zephyr REQUIRED HINTS $ENV{ZEPHYR_BASE})
project(pkcs7_parse)

target_sources(app PRIVATE src/main.c)

set(gen_dir ${ZEPHYR_BINARY_DIR}/include/generated/)

generate_inc_file_for_target(
    app
    data/good.pkcs7.der
    ${gen_dir}/good.pkcs7.der.inc
    )

generate_inc_file_for_target(
    app
    data/bad.pkcs7.der
    ${gen_dir}/bad.pkcs7.der.inc
    )

zephyr_include_directories(${APPLICATION_SOURCE_DIR}/src/tls_config)
```

## sample.yaml
```
sample:
  description: Test of PKCS7 parsing 
  name: PKCS7 parse
common:
    tags: pkcs7_parse
```

## prj.conf
```kconfig
# Networking
CONFIG_NET_NATIVE=y
CONFIG_NET_SOCKETS=y
CONFIG_NET_TCP=y
CONFIG_NET_TCP_ISN_RFC6528=n
CONFIG_NETWORKING=y
CONFIG_NET_IPV4=y
CONFIG_NET_IPV6=n

# Anjay Settings
CONFIG_ANJAY=y
CONFIG_ANJAY_COMPAT_NET=n
CONFIG_ANJAY_COMPAT_ZEPHYR_TLS=n
CONFIG_ANJAY_COMPAT_MBEDTLS=y
CONFIG_ANJAY_WITH_SEND=n
CONFIG_ANJAY_WITH_LWM2M11=n
CONFIG_ANJAY_WITH_CBOR=n
CONFIG_ANJAY_WITH_EST=y


# Logging
CONFIG_LOG=y
CONFIG_LOG_MODE_DEFERRED=n
CONFIG_LOG_BLOCK_IN_THREAD=y

CONFIG_ANJAY_WITH_LOGS=y
CONFIG_ANJAY_WITH_TRACE_LOGS=y
#CONFIG_ANJAY_LOG_LEVEL_INF=y
CONFIG_ANJAY_LOG_LEVEL_DBG=y

#
# mbedtls
#

CONFIG_CUSTOM_MBEDTLS_CFG_FILE=y
CONFIG_MBEDTLS_CFG_FILE="config-tls-generic.h"

CONFIG_MBEDTLS_USER_CONFIG_ENABLE=y
CONFIG_MBEDTLS_USER_CONFIG_FILE="user-tls-conf.h"

# Supported TLS version
CONFIG_MBEDTLS_TLS_VERSION_1_2=y
CONFIG_MBEDTLS_DTLS=y

# Supported key exchange modes
CONFIG_MBEDTLS_KEY_EXCHANGE_RSA_ENABLED=n
CONFIG_MBEDTLS_KEY_EXCHANGE_ECDHE_RSA_ENABLED=y     # To force MBEDTLS_RSA_C (to be able to verify RSA signature)
CONFIG_MBEDTLS_KEY_EXCHANGE_ECDHE_ECDSA_ENABLED=y

# Supported elliptic curves
CONFIG_MBEDTLS_ECP_DP_SECP256R1_ENABLED=y
CONFIG_MBEDTLS_ECP_DP_CURVE25519_ENABLED=y          # Enabled for ECDHE key exchange

# Supported cipher modes
CONFIG_MBEDTLS_CIPHER_DES_ENABLED=n
CONFIG_MBEDTLS_CIPHER_GCM_ENABLED=y
CONFIG_MBEDTLS_CIPHER_MODE_CBC_ENABLED=n

# Supported message authentication methods
CONFIG_MBEDTLS_MAC_SHA1_ENABLED=n
CONFIG_MBEDTLS_MAC_SHA256_ENABLED=y

# Random number generators
CONFIG_MBEDTLS_HMAC_DRBG_ENABLED=y

# Other configurations
CONFIG_MBEDTLS_GENPRIME_ENABLED=y
CONFIG_MBEDTLS_ENTROPY_ENABLED=y
CONFIG_MBEDTLS_PK_WRITE_C=y
CONFIG_MBEDTLS_ENABLE_HEAP=y
CONFIG_MBEDTLS_HEAP_SIZE=64000
# end of mbedtls

CONFIG_CBPRINTF_FP_SUPPORT=n
```

## src/main.c
```c
#include <zephyr.h>
#include <sys/printk.h>
#include <drivers/uart.h>
#include <drivers/gpio.h>
#include <net/net_mgmt.h>
#include <net/socket.h>

#include <mbedtls/x509_crt.h>
#include <mbedtls/x509_csr.h>
#include <mbedtls/oid.h>

#include <avsystem/commons/avs_log.h>
#include <avsystem/commons/avs_net.h>
#include <avsystem/commons/avs_prng.h>
#include <avsystem/commons/avs_sched.h>
#include <avsystem/commons/avs_utils.h>

/// @brief Certificate information string size
#define UI32_SIZE_CERT_INFO             2000

static const unsigned char pkcs7_good[] = {
   #include "good.pkcs7.der.inc"
};

static const unsigned char pkcs7_bad[] = {
   #include "bad.pkcs7.der.inc"
};


void parse_pkcs7_anjay(const unsigned char *cpc_Pkcs7Der, size_t z_Pkcs7DerLen)
{
   // For mbedtls
   int i_Ret;
   mbedtls_x509_crt k_MbedCerts;
   mbedtls_x509_crt *pk_MbedCurrentCert = &k_MbedCerts;

   // For Anjay
   AVS_LIST(avs_crypto_certificate_chain_info_t) pk_AvsCertList = NULL;
   AVS_LIST(avs_crypto_cert_revocation_list_info_t) pk_AvsCrlList = NULL;
   avs_crypto_certificate_chain_info_t *pk_AvsCert = NULL;
   avs_error_t k_AvsErr;

   // To print certificates
   char ac_CertInfo[UI32_SIZE_CERT_INFO] = { 0 };

   // Extract CRL and Certs from PKCS7 payload, using anjay
   k_AvsErr = avs_crypto_parse_pkcs7_certs_only(&pk_AvsCertList, &pk_AvsCrlList, cpc_Pkcs7Der, z_Pkcs7DerLen);

   if (avs_is_err(k_AvsErr))
   {
      printf("avs_crypto_parse_pkcs7_certs_only error\n");
      return;
   }

   mbedtls_x509_crt_init(&k_MbedCerts);

   // For each certificate in AVS_LIST
   AVS_LIST_FOREACH(pk_AvsCert, pk_AvsCertList)
   {
      // Add certificate to k_MbedCerts chained list
      i_Ret = mbedtls_x509_crt_parse(
         &k_MbedCerts,
         (const unsigned char *) pk_AvsCert->desc.info.buffer.buffer,
         pk_AvsCert->desc.info.buffer.buffer_size);

      if (i_Ret < 0)
      {
         printf("mbedtls_x509_crt_parse error %d\n", i_Ret);
         return;
      }
   }

   while (pk_MbedCurrentCert != NULL)
   {
      i_Ret = mbedtls_x509_crt_info( (char *) ac_CertInfo, sizeof(ac_CertInfo), "", pk_MbedCurrentCert);

      if (i_Ret < 0)
      {
         printf("mbedtls_x509_crt_info error %d\n", i_Ret);
         return;
      }

      printf("\n%s\n", ac_CertInfo);

      // Next certificate
      pk_MbedCurrentCert = pk_MbedCurrentCert->next;
   }

   // Free mbedtls_x509_crt* in chained list
   mbedtls_x509_crt_free(&k_MbedCerts);
   return;
}

void main(void)
{
   printf("\nDecode good.pkcs7.der using anjay\n");
   parse_pkcs7_anjay(pkcs7_good, sizeof(pkcs7_good));

   printf("\nDecode bad.pkcs7.der using anjay\n");
   parse_pkcs7_anjay(pkcs7_bad, sizeof(pkcs7_bad));
}
```
